## conf/machine/solo-imx6.conf
```bitbake
# Basic Solo machine stub; adjust as kernel/DTS work lands.

require conf/machine/imx6qsabresd.conf

MACHINEOVERRIDES =. "solo-imx6:"

KERNEL_DEVICETREE = "imx6solo-3dr.dtb imx6solo-3dr-analogtvin.dtb"
```
