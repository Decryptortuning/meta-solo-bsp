## conf/machine/imx_controller.conf
```bitbake
#@TYPE: Machine
#@NAME: 3DR Artoo Controller
#@SOC: i.MX6S
require conf/machine/include/solo-imx6-common.inc

KERNEL_DEVICETREE = "nxp/imx/imx6solo-controller.dtb"
UBOOT_CONFIG[sd] = "imx6_controller_defconfig,sdcard"
```

## conf/machine/imx_drone.conf
```bitbake
#@TYPE: Machine
#@NAME: 3DR Solo Drone
#@SOC: i.MX6S
require conf/machine/include/solo-imx6-common.inc

KERNEL_DEVICETREE = "nxp/imx/imx6solo-drone.dtb"
UBOOT_CONFIG[sd] = "imx6_drone_defconfig,sdcard"
```

## recipes-bsp/u-boot/files/board/3dr/3dr_hdtc/Kconfig
```kconfig
if TARGET_3DR_HDTC

config SYS_BOARD
	default "3dr_hdtc"

config SYS_VENDOR
	default "3dr"

config SYS_CONFIG_NAME
	default "3dr_hdtc"

config HDTC_CONSOLE_DEV
	string "Linux console device (bootargs)"
	default "ttymxc0"

config HDTC_CONTROLLER_POWER_HOLD
	bool "Controller STM32/i.MX power holds"
	help
	  Assert the controller-only GPIO1_IO19/21 holds before Linux.
	  The Linux controller power driver releases them at final power-off.

config TEXT_BASE
	default 0x17800000

endif
```

## recipes-kernel/linux/linux-imx/files/Documentation/devicetree/bindings/power/reset/opensolo,controller-power-hold.yaml
```yaml
# SPDX-License-Identifier: GPL-2.0-only OR BSD-2-Clause
%YAML 1.2
---
$id: http://devicetree.org/schemas/power/reset/opensolo,controller-power-hold.yaml#
$schema: http://devicetree.org/meta-schemas/core.yaml#

title: OpenSolo controller STM32 and i.MX power holds

maintainers:
  - OpenSolo <decryptortuning@gmail.com>

description: |
  Two i.MX GPIOs retain controller power across STM32 reset and Linux reboot.
  Both are asserted high at boot. They are released to input mode at final
  power-off, allowing the STM32 mainboard's power circuit to shut down.

properties:
  compatible:
    const: opensolo,controller-power-hold
  hold-gpios:
    minItems: 2
    maxItems: 2
    description: Active-high controller power holds (GPIO1_IO19 and GPIO1_IO21).

required:
  - compatible
  - hold-gpios

additionalProperties: false
```
